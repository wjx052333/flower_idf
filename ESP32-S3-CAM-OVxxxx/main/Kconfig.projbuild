## ESP32-S3-CAM-OVxxxx/main/Kconfig.projbuild
```kconfig
menu "Flower CAM Device Configuration"

config WIFI_SSID
    string "WiFi SSID"
    default ""

config WIFI_PASSWORD
    string "WiFi Password"
    default ""

config MQTT_BROKER_URI
    string "MQTT Broker URI"
    default ""

config FLOWER_USER_ID
    string "Flower User ID"
    default "floweruser0"
    help
        User ID used in MQTT topic paths for audio and agent messages.
        Topics follow the pattern: flower/{user_id}/{device_id}/down/opus

config AUTO_TEST
    bool "Enable automatic MQTT voice test on boot"
    default n
    help
        When enabled, the device runs a pre-encoded Opus voice test sequence
        after MQTT connects (tools inquiry + 3-turn conversation).
        Disable for normal production use.

config USE_AUDIO_PROCESSOR
    bool "Enable AFE audio processor (AEC+NS)"
    default y
    help
        Enable AfeAudioProcessor for echo cancellation and noise suppression
        during voice calls. Disable to use NoAudioProcessor (pass-through).
        Note: AfeAudioProcessor requires additional DRAM.

config USE_DEVICE_AEC
    bool "Enable device-side AEC"
    default y
    help
        Enable acoustic echo cancellation on the device side.

menu "Camera DVP Pin Configuration"
    comment "Default values match the ESP32-S3-EYE / OV5640 DVP layout."

    config CAM_SCCB_I2C_PORT
        int "SCCB (I2C) port number"
        default 0
        range 0 1

    config CAM_SCCB_I2C_FREQ
        int "SCCB (I2C) frequency (Hz)"
        default 100000
        range 100000 400000

    config CAM_SCCB_SCL_PIN
        int "SCCB (I2C) SCL pin"
        default 5
        range 0 48

    config CAM_SCCB_SDA_PIN
        int "SCCB (I2C) SDA pin"
        default 4
        range 0 48

    config CAM_RESET_PIN
        int "Camera RESET pin (-1 = not connected)"
        default -1
        range -1 48

    config CAM_PWDN_PIN
        int "Camera PWDN pin (-1 = not connected)"
        default -1
        range -1 48

    config CAM_XCLK_PIN
        int "XCLK output pin"
        default 15
        range 0 48

    config CAM_XCLK_FREQ
        int "XCLK frequency (Hz)"
        default 20000000

    config CAM_PCLK_PIN
        int "PCLK input pin"
        default 13
        range 0 48

    config CAM_VSYNC_PIN
        int "VSYNC input pin"
        default 6
        range 0 48

    config CAM_DE_PIN
        int "DE (HREF) input pin"
        default 7
        range 0 48

    config CAM_D0_PIN
        int "Data bit 0 pin"
        default 11
        range 0 48

    config CAM_D1_PIN
        int "Data bit 1 pin"
        default 9
        range 0 48

    config CAM_D2_PIN
        int "Data bit 2 pin"
        default 8
        range 0 48

    config CAM_D3_PIN
        int "Data bit 3 pin"
        default 10
        range 0 48

    config CAM_D4_PIN
        int "Data bit 4 pin"
        default 12
        range 0 48

    config CAM_D5_PIN
        int "Data bit 5 pin"
        default 18
        range 0 48

    config CAM_D6_PIN
        int "Data bit 6 pin"
        default 17
        range 0 48

    config CAM_D7_PIN
        int "Data bit 7 pin"
        default 16
        range 0 48

endmenu

endmenu
```

## ESP32-S3-CAM-OVxxxx/sdkconfig.defaults
```kconfig
# Flash size (ESP32-S3R8: 16MB flash + 8MB PSRAM)
CONFIG_ESPTOOLPY_FLASHSIZE_16MB=y
CONFIG_ESPTOOLPY_FLASHSIZE="16MB"

# CPU frequency — 240MHz required for AFE real-time DSP (AEC + NS)
CONFIG_ESP_DEFAULT_CPU_FREQ_MHZ_240=y

# PSRAM (ESP32-S3R8: 16MB flash + 8MB PSRAM, needed for UYVY framebuffers)
CONFIG_SPIRAM=y
CONFIG_SPIRAM_MODE_OCT=y
CONFIG_SPIRAM_SPEED_80M=y
CONFIG_SPIRAM_USE_MALLOC=y

# Match xiaozhi-esp32 PSRAM alloc thresholds
CONFIG_SPIRAM_MALLOC_ALWAYSINTERNAL=2048
CONFIG_SPIRAM_MALLOC_RESERVE_INTERNAL=98304
CONFIG_MBEDTLS_EXTERNAL_MEM_ALLOC=y

# OTA: allow plain HTTP firmware URLs (for local dev server)
CONFIG_ESP_HTTPS_OTA_ALLOW_HTTP=y

# Partition table
CONFIG_PARTITION_TABLE_CUSTOM=y
CONFIG_PARTITION_TABLE_CUSTOM_FILENAME="partitions.csv"

# WiFi
CONFIG_WIFI_SSID="YOUR_SSID"
CONFIG_WIFI_PASSWORD="YOUR_PASSWORD"

# MQTT broker
CONFIG_MQTT_BROKER_URI="mqtts://your-broker:8883"

# TLS: skip cert check (dev only)
CONFIG_ESP_TLS_INSECURE=y
CONFIG_ESP_TLS_SKIP_SERVER_CERT_VERIFY=y

# Enable MQTT 5.0
CONFIG_MQTT_PROTOCOL_5=y

# MQTT task stack
CONFIG_MQTT_TASK_STACK_SIZE=16384

# MQTT out-buffer large enough to hold a full JPEG snapshot (VGA~30KB + margin)
CONFIG_MQTT_BUFFER_SIZE=65536

# WiFi/LWIP memory optimizations (reduce internal DRAM pressure)
CONFIG_ESP_WIFI_STATIC_RX_BUFFER_NUM=3
CONFIG_ESP_WIFI_DYNAMIC_RX_BUFFER_NUM=6
CONFIG_ESP_WIFI_RX_BA_WIN=3
CONFIG_LWIP_TCPIP_RECVMBOX_SIZE=16
CONFIG_MBEDTLS_DYNAMIC_FREE_CONFIG_DATA=y

# Cache optimizations
CONFIG_ESP32S3_INSTRUCTION_CACHE_32KB=y
CONFIG_ESP32S3_DATA_CACHE_LINE_64B=y

# SR models — auto-packed by esp-sr's movemodel.py during build
CONFIG_SR_WN_WN9_MIAOMIAOTONGXUE_TTS=y
CONFIG_SR_NSN_NSNET2=y

# Auto-test (disabled by default; set =y to enable MQTT voice test on boot)
# CONFIG_AUTO_TEST=y

# AFE audio processor (AEC + noise suppression)
CONFIG_USE_AUDIO_PROCESSOR=y

# Compiler optimization (required for AFE real-time DSP: AEC + NS)
CONFIG_COMPILER_OPTIMIZATION_SIZE=y

# Logging
CONFIG_LOG_DEFAULT_LEVEL_INFO=y

# Target
CONFIG_IDF_TARGET="esp32s3"

# Enable C++ RTTI (required for dynamic_cast in AudioService)
CONFIG_COMPILER_CXX_RTTI=y

# DVP camera — enable DVP device in esp_video
CONFIG_ESP_VIDEO_ENABLE_DVP_VIDEO_DEVICE=y

# OV5640 sensor driver + DVP auto-detect
CONFIG_CAMERA_OV5640=y
CONFIG_CAMERA_OV5640_AUTO_DETECT_DVP_INTERFACE_SENSOR=y

# Software JPEG encoder (used for non-native-JPEG camera output on ESP32-S3)
# esp_new_jpeg is selected automatically via idf_component.yml

# Camera DVP pin configuration
CONFIG_CAM_SCCB_I2C_PORT=0
CONFIG_CAM_SCCB_I2C_FREQ=100000
CONFIG_CAM_SCCB_SCL_PIN=7
CONFIG_CAM_SCCB_SDA_PIN=8
CONFIG_CAM_RESET_PIN=-1
CONFIG_CAM_PWDN_PIN=-1
CONFIG_CAM_XCLK_PIN=38
CONFIG_CAM_PCLK_PIN=41
CONFIG_CAM_VSYNC_PIN=17
CONFIG_CAM_DE_PIN=18
CONFIG_CAM_D0_PIN=45
CONFIG_CAM_D1_PIN=47
CONFIG_CAM_D2_PIN=48
CONFIG_CAM_D3_PIN=46
CONFIG_CAM_D4_PIN=42
CONFIG_CAM_D5_PIN=40
CONFIG_CAM_D6_PIN=39
CONFIG_CAM_D7_PIN=21
CONFIG_CAM_XCLK_FREQ=20000000

# XCLK via LEDC (required for DVP clock output)
CONFIG_CAMERA_XCLK_USE_LEDC=y

# SCCB / I2C timeout
CONFIG_ESP_SCCB_TRANS_TIMEOUT_DEFAULT=500

# Video parameter checking
CONFIG_ESP_VIDEO_CHECK_PARAMETERS=y

# Main task stack (event loop runs protobuf encode + audio draining)
CONFIG_ESP_MAIN_TASK_STACK_SIZE=8192
```

## emakefun_esp32_s3r8_camera/main/Kconfig.projbuild
```kconfig
menu "Flower CAM Device Configuration"

config WIFI_SSID
    string "WiFi SSID"
    default ""

config WIFI_PASSWORD
    string "WiFi Password"
    default ""

config MQTT_BROKER_URI
    string "MQTT Broker URI"
    default ""

menu "Camera DVP Pin Configuration"
    comment "Default values match the emakefun ESP32-S3-R8 / ESP32S3_EYE layout."

    config CAM_SCCB_I2C_PORT
        int "SCCB (I2C) port number"
        default 0
        range 0 1

    config CAM_SCCB_I2C_FREQ
        int "SCCB (I2C) frequency (Hz)"
        default 100000
        range 100000 400000

    config CAM_SCCB_SCL_PIN
        int "SCCB (I2C) SCL pin"
        default 5
        range 0 48

    config CAM_SCCB_SDA_PIN
        int "SCCB (I2C) SDA pin"
        default 4
        range 0 48

    config CAM_RESET_PIN
        int "Camera RESET pin (-1 = not connected)"
        default -1
        range -1 48

    config CAM_PWDN_PIN
        int "Camera PWDN pin (-1 = not connected)"
        default -1
        range -1 48

    config CAM_XCLK_PIN
        int "XCLK output pin"
        default 15
        range 0 48

    config CAM_XCLK_FREQ
        int "XCLK frequency (Hz)"
        default 20000000

    config CAM_PCLK_PIN
        int "PCLK input pin"
        default 13
        range 0 48

    config CAM_VSYNC_PIN
        int "VSYNC input pin"
        default 6
        range 0 48

    config CAM_DE_PIN
        int "DE (HREF) input pin"
        default 7
        range 0 48

    config CAM_D0_PIN
        int "Data bit 0 pin"
        default 11
        range 0 48

    config CAM_D1_PIN
        int "Data bit 1 pin"
        default 9
        range 0 48

    config CAM_D2_PIN
        int "Data bit 2 pin"
        default 8
        range 0 48

    config CAM_D3_PIN
        int "Data bit 3 pin"
        default 10
        range 0 48

    config CAM_D4_PIN
        int "Data bit 4 pin"
        default 12
        range 0 48

    config CAM_D5_PIN
        int "Data bit 5 pin"
        default 18
        range 0 48

    config CAM_D6_PIN
        int "Data bit 6 pin"
        default 17
        range 0 48

    config CAM_D7_PIN
        int "Data bit 7 pin"
        default 16
        range 0 48

    config CAM_LED_GPIO
        int "Flash LED GPIO (-1 = none)"
        default 3
        range -1 48
        help
            GPIO for the flash LED (GPIO 3 on emakefun ESP32-S3-R8).
            Turned on briefly during each snapshot capture.

endmenu

endmenu
```

## emakefun_esp32_s3r8_camera/sdkconfig.defaults
```kconfig
# Flash / PSRAM (emakefun ESP32-S3-R8: 8MB flash + 8MB PSRAM)
CONFIG_ESPTOOLPY_FLASHSIZE_8MB=y
CONFIG_ESPTOOLPY_FLASHSIZE="8MB"

CONFIG_SPIRAM=y
CONFIG_SPIRAM_MODE_OCT=y
CONFIG_SPIRAM_SPEED_80M=y
CONFIG_SPIRAM_USE_MALLOC=y

# OTA: allow plain HTTP firmware URLs (for local dev server)
CONFIG_ESP_HTTPS_OTA_ALLOW_HTTP=y

# Partition table
CONFIG_PARTITION_TABLE_CUSTOM=y
CONFIG_PARTITION_TABLE_CUSTOM_FILENAME="partitions.csv"

# WiFi
CONFIG_WIFI_SSID="YOUR_SSID"
CONFIG_WIFI_PASSWORD="YOUR_PASSWORD"

# MQTT broker
CONFIG_MQTT_BROKER_URI="mqtts://your-broker:8883"

# TLS: skip cert check (dev only)
CONFIG_ESP_TLS_INSECURE=y
CONFIG_ESP_TLS_SKIP_SERVER_CERT_VERIFY=y

# Enable MQTT 5.0
CONFIG_MQTT_PROTOCOL_5=y

# MQTT task stack
CONFIG_MQTT_TASK_STACK_SIZE=10240

# MQTT out-buffer large enough to hold a full JPEG snapshot (~30KB + margin)
CONFIG_MQTT_BUFFER_SIZE=65536

# Logging
CONFIG_LOG_DEFAULT_LEVEL_INFO=y

# Target
CONFIG_IDF_TARGET="esp32s3"

# DVP camera
CONFIG_ESP_VIDEO_ENABLE_DVP_VIDEO_DEVICE=y

# OV3660 sensor driver + DVP auto-detect
CONFIG_CAMERA_OV3660=y
CONFIG_CAMERA_OV3660_AUTO_DETECT_DVP_INTERFACE_SENSOR=y

# XCLK via LEDC (required for DVP clock output)
CONFIG_CAMERA_XCLK_USE_LEDC=y

# SCCB / I2C timeout
CONFIG_ESP_SCCB_TRANS_TIMEOUT_DEFAULT=500

# Video parameter checking
CONFIG_ESP_VIDEO_CHECK_PARAMETERS=y

# PSRAM alloc thresholds
CONFIG_SPIRAM_MALLOC_ALWAYSINTERNAL=2048
CONFIG_MBEDTLS_EXTERNAL_MEM_ALLOC=y

# Camera DVP pin configuration — emakefun ESP32-S3-R8 / ESP32S3_EYE layout
CONFIG_CAM_SCCB_I2C_PORT=0
CONFIG_CAM_SCCB_I2C_FREQ=100000
CONFIG_CAM_SCCB_SCL_PIN=5
CONFIG_CAM_SCCB_SDA_PIN=4
CONFIG_CAM_RESET_PIN=-1
CONFIG_CAM_PWDN_PIN=-1
CONFIG_CAM_XCLK_PIN=15
CONFIG_CAM_PCLK_PIN=13
CONFIG_CAM_VSYNC_PIN=6
CONFIG_CAM_DE_PIN=7
CONFIG_CAM_D0_PIN=11
CONFIG_CAM_D1_PIN=9
CONFIG_CAM_D2_PIN=8
CONFIG_CAM_D3_PIN=10
CONFIG_CAM_D4_PIN=12
CONFIG_CAM_D5_PIN=18
CONFIG_CAM_D6_PIN=17
CONFIG_CAM_D7_PIN=16
CONFIG_CAM_XCLK_FREQ=20000000

# Flash LED (GPIO 3 on emakefun ESP32-S3-R8)
CONFIG_CAM_LED_GPIO=3
```

## esp32_cam_ai_thinker/sdkconfig.defaults
```kconfig
# Flash / PSRAM (AI Thinker ESP32-CAM: 4MB flash + 4MB Quad PSRAM)
CONFIG_ESPTOOLPY_FLASHSIZE_4MB=y
CONFIG_ESPTOOLPY_FLASHSIZE="4MB"

CONFIG_SPIRAM=y
CONFIG_SPIRAM_SPEED_80M=y
CONFIG_SPIRAM_USE_MALLOC=y

# OTA: allow plain HTTP firmware URLs (for local dev server)
CONFIG_ESP_HTTPS_OTA_ALLOW_HTTP=y

# Partition table
CONFIG_PARTITION_TABLE_CUSTOM=y
CONFIG_PARTITION_TABLE_CUSTOM_FILENAME="partitions.csv"

# WiFi
CONFIG_WIFI_SSID="YOUR_SSID"
CONFIG_WIFI_PASSWORD="YOUR_PASSWORD"

# MQTT broker
CONFIG_MQTT_BROKER_URI="mqtts://your-broker:8883"

# TLS: skip cert check (dev only)
CONFIG_ESP_TLS_INSECURE=y
CONFIG_ESP_TLS_SKIP_SERVER_CERT_VERIFY=y

# Enable MQTT 5.0
CONFIG_MQTT_PROTOCOL_5=y

# MQTT task stack
CONFIG_MQTT_TASK_STACK_SIZE=10240

# MQTT out-buffer large enough for a full JPEG snapshot
CONFIG_MQTT_BUFFER_SIZE=65536

# Logging
CONFIG_LOG_DEFAULT_LEVEL_INFO=y

# lwIP TCP send buffer — must be large enough for UXGA JPEG (~250KB)
CONFIG_LWIP_TCP_SND_BUF_DEFAULT=65535
CONFIG_LWIP_TCP_WND_DEFAULT=65535
CONFIG_LWIP_TCP_RECVMBOX_SIZE=12
CONFIG_LWIP_TCPIP_RECVMBOX_SIZE=32

# httpd: allow large responses and longer send timeout
CONFIG_HTTPD_MAX_REQ_HDR_LEN=1024
CONFIG_HTTPD_RESP_SEND_TIMEOUT=30

# Target
CONFIG_IDF_TARGET="esp32"

# PSRAM alloc thresholds
CONFIG_SPIRAM_MALLOC_ALWAYSINTERNAL=2048
CONFIG_MBEDTLS_EXTERNAL_MEM_ALLOC=y
```

## relay/main/Kconfig.projbuild
```kconfig
menu "Flower Device Configuration"

config WIFI_SSID
    string "WiFi SSID"
    default ""

config WIFI_PASSWORD
    string "WiFi Password"
    default ""

config DEVICE_ID
    string "Device ID"
    default "dev-005"

config DEVICE_SECRET
    string "Device Secret (HMAC-SHA256 key)"
    default ""

config MQTT_BROKER_URI
    string "MQTT Broker URI"
    default ""

endmenu
```

## relay/sdkconfig.defaults
```kconfig
# Partition table
CONFIG_PARTITION_TABLE_CUSTOM=y
CONFIG_PARTITION_TABLE_CUSTOM_FILENAME="partitions.csv"

# WiFi
CONFIG_WIFI_SSID="CU_home"
CONFIG_WIFI_PASSWORD="wastemytimehome123456789"

# MQTT broker
CONFIG_MQTT_BROKER_URI="mqtts://58.87.80.78:8883"

# TLS: skip cert check (dev only)
CONFIG_ESP_TLS_INSECURE=y
CONFIG_ESP_TLS_SKIP_SERVER_CERT_VERIFY=y

# Enable MQTT 5.0 (required for User Properties)
CONFIG_MQTT_PROTOCOL_5=y

# MQTT task stack
CONFIG_MQTT_TASK_STACK_SIZE=6144

# Logging
CONFIG_LOG_DEFAULT_LEVEL_INFO=y
```

## relay_four/main/Kconfig.projbuild
```kconfig
menu "Flower Device Configuration"

config WIFI_SSID
    string "WiFi SSID"
    default ""

config WIFI_PASSWORD
    string "WiFi Password"
    default ""

config MQTT_BROKER_URI
    string "MQTT Broker URI"
    default ""

endmenu
```
